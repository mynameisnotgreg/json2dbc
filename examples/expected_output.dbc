VERSION ""

NS_ :

BS_: 500

BU_: DEBUG BOB JANE JOE

BO_ 10 BOB_potato_salad: 3 JANE
    SG_ potato : 0|16@1- (1,0) [-30000|30000] "P" JANE
    SG_ salad : 16|3@1+ (1,0) [0|7] "" JANE

BO_ 20 BOB_chicken_salad: 4 DEBUG
    SG_ chicken : 0|14@1- (1,0) [-10|-3] "" DEBUG
    (* TODO: EGG!! *)
    SG_ salad : 14|12@0-  (-0.25,500) [-500|1000] "" DEBUG

BA_DEF_ BO_  "GenMsgCycleTime" INT 0 65535;
BA_DEF_ SG_  "GenSigStartValue" INT 0 2147483647;

BA_DEF_DEF_  "GenMsgCycleTime" 0;
BA_DEF_DEF_  "GenSigStartValue" 0;

BA_ "GenSigStartValue" SG_ 20 salad 123;

BA_ "GenMsgCycleTime" BO_ 20 10;
